## CMakeLists.txt
```
# SPDX-License-Identifier: Apache-2.0

cmake_minimum_required(VERSION 3.13.1)
find_package(Zephyr REQUIRED HINTS $ENV{ZEPHYR_BASE})
project(app)

target_sources(app PRIVATE src/main.cpp src/DebugBlinker.cpp src/MotorController.cpp src/EncoderAnalyzer.cpp src/DebugPrinter.cpp src/BluetoothModule.cpp)

target_include_directories(app PRIVATE ./src)
```

## sample.yaml
```
sample:
  name: WirelessDeskController
tests:
  Ensto_Aalto_Wireless_control_unit_of_electric_desk:
    tags: cpp
    toolchain_exclude: issm
    arch_exclude: posix
    harness: console
    harness_config:
      type: multi_line
      regex:
        - "Create semaphore (.*)"
        - "main: Hello World!"
        - "coop_thread_entry: Hello World!"
```

## prj.conf
```kconfig
CONFIG_GPIO=y
CONFIG_ADC=y
CONFIG_CPLUSPLUS=y
CONFIG_MINIMAL_LIBC_MALLOC_ARENA_SIZE=128

CONFIG_BT=y

CONFIG_BT_PERIPHERAL=y
CONFIG_BT_GATT_CLIENT=y
CONFIG_BT_GATT_DYNAMIC_DB=y

CONFIG_BT_DEVICE_NAME="TABLE"
```

## src/main.cpp
```c
#include <zephyr.h>
#include "DebugBlinker.hpp"
#include "MotorController.hpp"

#include "DebugPrinter.hpp"
#include "BluetoothModule.hpp"
#include <string.h>
#define ONE_SECOND 1000
#include <stdio.h>
//for usb debug console messages
#include <sys/printk.h>
#include <sys/util.h>

void main(void)
{
	DebugBlinker ledOne(1);
	DebugBlinker ledTwo(2);
	DebugBlinker ledThree(3);
	DebugPrinter printer;
	ledThree.ledOff();
	ledOne.ledOff();
	ledTwo.ledOff();
	MotorController controller;
	startBluetooth(&controller);
	controller.run();
}
```

## src/BluetoothModule.cpp
```c
#include "BluetoothModule.hpp"
#include "DebugBlinker.hpp"
#include "DebugPrinter.hpp"

#include <zephyr/types.h>
#include <stddef.h>
#include <sys/printk.h>
#include <sys/util.h>

#include <bluetooth/bluetooth.h>
#include <bluetooth/hci.h>
#include <bluetooth/conn.h>
#include <bluetooth/uuid.h>
#include <bluetooth/gatt.h>
#include <sys/byteorder.h>
#include <bluetooth/services/hrs.h>

DebugPrinter printer;
MotorController* controllerSet = nullptr;

void changeController(MotorController* controller)
{
	controllerSet = controller;
}
/*const struct bt_uuid_16 tableControlUUID16 =
{
	.uuid = {BT_UUID_TYPE_16},
	.val = (TABLE_CONTROL_SERVICE_UUID)
};*/

//bt_uuid tableControlUUID;
//this is the UUID our table control service uses.
bt_uuid_128 tableControlUUID = BT_UUID_INIT_128(
	BT_UUID_128_ENCODE(0x6495c7ad,0xe0cc,0x4c2c,0x87c8,0xe8ad2f964b03));

//this is the actual data struct being sent through bluetooth low-energy. The size of this is hard-capped to 512 bytes defined by the bluetooth low-energy standard
typedef struct TableSteeringData
{
	//the new target height the user wants to reach
	short tableTargetHeight;
	//an integer which the service can use to differentiate between different users.
	//Currently there is no any sort of service in place that provides a fail-safe guarantee of uniqueness though
	//int userIdentifier;
} TableSteeringData;

static TableSteeringData steeringData = {-1};
//callback functions associated with the GATT bluetooth low-energy layer

//this gets called when a GATT attribute has been received(?)
static ssize_t received(struct bt_conn *conn, const struct bt_gatt_attr *attr, void *buf, uint16_t len, uint16_t offset)
{
	printer << "SteeringData received\n";
	return 0;
}
//this gets called when a GATT attribute has been written to(?)
static ssize_t written(struct bt_conn *conn, const struct bt_gatt_attr *attr, const void *buf, uint16_t len, uint16_t offset, uint8_t flags)
{
	const char* value = (char*)attr->user_data;
	printer.PrintInt(*(short*)buf);
	steeringData.tableTargetHeight = *(short*)buf;
	if(controllerSet)
	{
		controllerSet->steerRequest(steeringData.tableTargetHeight);
	}
	return 1;
}
//GATT attribute that carries with it the data payload required to steer the table
/*static struct bt_gatt_attr tableSteerRequest = 
{
	//WARNING: THE FOLLOWING LINE IS SHADY
	.uuid = &(bt_uuid*)tableControlUUID,
	.read = received,
	.write = written,
	.user_data = &steeringData,
	.perm = (BT_GATT_PERM_READ | BT_GATT_PERM_WRITE)
};*/
/*static struct bt_gatt_service tableControlService =
{
	//we should be needing only one attribute here
	.attrs = &tableSteerRequest,
	.attr_count = 1,
	//sys_snode_t node <- no idea what this is. Who knows if it's important
};*/

BT_GATT_SERVICE_DEFINE(tableControlService,
	BT_GATT_PRIMARY_SERVICE(&tableControlUUID),
	BT_GATT_CHARACTERISTIC(&tableControlUUID.uuid,
				BT_GATT_CHRC_READ | BT_GATT_CHRC_WRITE,
				BT_GATT_PERM_READ | BT_GATT_PERM_WRITE,
				received, written, &steeringData),
);
	


//the board keeps repeating sending this data to the air repeatedly (and then waits for potential connections?)
static const struct bt_data advertisingData[] = {
	BT_DATA_BYTES(BT_DATA_FLAGS, BT_LE_AD_GENERAL | BT_LE_AD_NO_BREDR),
	BT_DATA_BYTES(BT_DATA_UUID16_ALL, 0xaa, 0xfe),
	BT_DATA_BYTES(BT_DATA_UUID128_ALL, BT_UUID_128_ENCODE(0x6495c7ad,0xe0cc,0x4c2c,0x87c8,0xe8ad2f964b03))
};

static const struct bt_data scanResponseData[] = {
	BT_DATA(BT_DATA_NAME_COMPLETE, DEVICE_NAME, DEVICE_NAME_LEN),
};

//callback functions associated with the GATT bluetooth low-energy layer
namespace GAPCallbacks
{
	static void connected(struct bt_conn *connection, uint8_t error)
	{
		char address[BT_ADDR_LE_STR_LEN];

		bt_addr_le_to_str(bt_conn_get_dst(connection), address, sizeof(address));

		if (error) {
			declareException();
			return;
		}

		printer << "connected to: " << address << "\n";
	}

	static void disconnected(struct bt_conn *connection, uint8_t reason)
	{
		char address[BT_ADDR_LE_STR_LEN];

		bt_addr_le_to_str(bt_conn_get_dst(connection), address, sizeof(address));

		printer << "Disconnected from " << address << ". Reason: " << reason << "\n";
	}
};


struct bt_conn_cb connectionCallbacks
{
	.connected = GAPCallbacks::connected,
	.disconnected = GAPCallbacks::disconnected,
};


//this struct defines how the board sends advertisements
static struct bt_le_adv_param advertisingParameters =
{
	.id = BT_ID_DEFAULT,
	.sid = 0,
	.secondary_max_skip = 0,
	.options = (BT_LE_ADV_OPT_CONNECTABLE | BT_LE_ADV_OPT_SCANNABLE),
	.interval_min = BT_GAP_ADV_FAST_INT_MIN_2,
	.interval_max = BT_GAP_ADV_FAST_INT_MAX_2,
	.peer = NULL,
};

//callback when bluetooth is enabled
void bluetoothReady(int error)
{
	if (error) {
		printer << "Exception in bluetoothReady\n";
		declareException();
		return;
	}

	//1000 as an array of 8 bits. This code is a bit shady...
	/*uint8_t UUIDBuffer[4] = { 0b0000, 0b0000, 0b1110, 0b1000 };
	bool succesfullyCreated = bt_uuid_create( tableControlUUID, UUIDBuffer, 4);
	if(!succesfullyCreated)
	{
		printer << "Exception in bluetoothReady -> bt_uuid_create\n";
		declareException();
	}*/
	//error = bt_gatt_service_register(&tableControlService);
	if(error)
	{
		printer << "Exception in bluetoothReady -> bt_gatt_service_register\n";
		declareException();
	}

	//the bluetooth module is ready for use: therefore we should begin advertising
	error = bt_le_adv_start(&advertisingParameters, advertisingData, ARRAY_SIZE(advertisingData), scanResponseData, ARRAY_SIZE(scanResponseData));
	if (error) {
		printer << "Exception in bluetoothReady -> bt_le_adv_start\n";
		declareException();
		return;
	}
	printer << "bluetooth ready\n";
}

void startBluetooth(MotorController* controller)
{
	changeController(controller);
	bt_conn_cb_register(&connectionCallbacks);
	int error = bt_enable(bluetoothReady);
	if(error)
	{
		printer << "Exception in startBluetooth\n";
		declareException();
	}
	printer << "bluetooth starting\n";
}
```

## src/BluetoothModule.hpp
```c
#ifndef BLUETOOTH_HPP
#define BLUETOOTH_HPP
//NRF52840 in this prototype is supposed to work in bluetooth low energy peripheral role.
//This module is implemented without a class. classes seem to make callback handling just more difficult and zephy's bluetooth library works mostly on them
//maximum amount of paired devices supported by bluetooth
#include "MotorController.hpp"
#define CONFIG_BT_MAX_PAIRED 1
//maximum amount of connections supported by bluetooth
#define CONFIG_BT_MAX_CONN 1

#define DEVICE_NAME CONFIG_BT_DEVICE_NAME
#define DEVICE_NAME_LEN (sizeof(DEVICE_NAME) - 1)

void bluetoothReadyCallback(int err);
void startBluetooth(MotorController* controller);
//sets the controller object which the bluetooth functionality sends it's data to
void changeController(MotorController* controller);


#endif
```

## src/DebugBlinker.cpp
```c
#include "DebugBlinker.hpp"

#include <device.h>
#include <devicetree.h>
#include <zephyr.h>
#include <drivers/gpio.h>
#include <stdio.h>
#include <stdlib.h>

//there might be redundant FLAGS here but lets get this working first
#define LED0_NODE DT_ALIAS(led0)
#define LED0 DT_GPIO_LABEL(LED0_NODE, gpios)
#define PIN0 DT_GPIO_PIN(LED0_NODE, gpios)
#define FLAGS0 DT_GPIO_FLAGS(LED0_NODE, gpios)

#define LED1_NODE DT_ALIAS(led1)
#define LED1 DT_GPIO_LABEL(LED1_NODE, gpios)
#define PIN1 DT_GPIO_PIN(LED1_NODE, gpios)
#define FLAGS1 DT_GPIO_FLAGS(LED1_NODE, gpios)

#define LED2_NODE DT_ALIAS(led2)
#define LED2 DT_GPIO_LABEL(LED2_NODE, gpios)
#define PIN2 DT_GPIO_PIN(LED2_NODE, gpios)
#define FLAGS2 DT_GPIO_FLAGS(LED2_NODE, gpios)

#define LED3_NODE DT_ALIAS(led3)
#define LED3 DT_GPIO_LABEL(LED3_NODE, gpios)
#define PIN3 DT_GPIO_PIN(LED3_NODE, gpios)
#define FLAGS3 DT_GPIO_FLAGS(LED3_NODE, gpios)

//no static variables in Zephyr confirmed. This was learned the hard way... I suggest static variables that are shared by instances of a class could be
//implemented like this: as global variables inside a class specific cpp file as they then won't be included any place else. Or put into a namespace
//Or the concept could be ditched entirely and just code everything with local variables.
struct device* leds[USABLE_LED_COUNT];
uint8_t pins[USABLE_LED_COUNT];
bool DB_initialized = false;
bool virtualLeds[USABLE_LED_COUNT];
bool DB_exceptionIsDeclared = false;
bool debugSwoInitilized = false;


void declareException()
{
    if(!exceptionIsDeclared())
    {
    struct device* exceptionLed = device_get_binding("GPIO_0");
    gpio_pin_configure(exceptionLed, PIN3, GPIO_OUTPUT_ACTIVE | FLAGS3);
    gpio_pin_set(exceptionLed, PIN3, 1);
    }
}

bool exceptionIsDeclared()
{
    if(DB_exceptionIsDeclared)
    {
        return true;
    }
    return false;
}


DebugBlinker::DebugBlinker(int led_)
{
    //gets initialized automatically the first time a DebugBlinker object is constructed and never afterwards
    if( !(led_ < 1 || led_ > USABLE_LED_COUNT) )
    {
        led = led_-1;
        if(!DB_initialized)
        {
            DB_initialized = true;
            leds[0] = device_get_binding(LED0);
            leds[1] = device_get_binding(LED1);
            leds[2] = device_get_binding(LED2);
            pins[0] = PIN0;
            pins[1] = PIN1;
            pins[2] = PIN2;
            gpio_pin_configure(leds[0], PIN0, GPIO_OUTPUT_ACTIVE | FLAGS0);
            gpio_pin_configure(leds[1], PIN1, GPIO_OUTPUT_ACTIVE | FLAGS1);
            gpio_pin_configure(leds[2], PIN2, GPIO_OUTPUT_ACTIVE | FLAGS2);
        }
    }
    else
    {
        declareException();
        //lets see if exeptions work in Zephyr
        //throw std::out_of_range("Error: DebugBlinky only supports leds indexed as 1, 2 or 3");
        //Unfortunately no c++-style exception handling in Zephyr confirmed. Looking for alternatives...
    }
}

void DebugBlinker::ledOn()
{
    //led = PIN.
    gpio_pin_set(leds[led], pins[led], 1);
}

void DebugBlinker::ledOff()
{
    gpio_pin_set(leds[led], pins[led], 0);
}

void numberToBlinks(int number)
{
    DebugBlinker ledOne(1);
    DebugBlinker ledTwo(2);
    DebugBlinker ledThree(3);
    ledOne.ledOn();
    ledTwo.ledOn();
    ledThree.ledOn();
    k_msleep(2000);
    ledOne.ledOff();
    ledTwo.ledOff();
    ledThree.ledOff();
    k_msleep(500);
    char buffer[20] = {0};
    sprintf(buffer, "%d", number);
    for(char* c = buffer; *c != 0; c++)
    {
        ledTwo.ledOn();
        k_msleep(2000);
        ledTwo.ledOff();
        k_msleep(2000);
        ledOne.ledOff();
        if(*c == '-')
        {
            ledThree.ledOn();
            continue;
        }
        for(unsigned char k = (*c)-48; k > 0; k--)
        {
            k_msleep(1000);
            ledOne.ledOn();
            k_msleep(500);
            ledOne.ledOff();
        }
    }
    k_msleep(500);
    ledOne.ledOn();
    ledTwo.ledOn();
    ledThree.ledOn();
    k_msleep(500);
    ledOne.ledOff();
    ledTwo.ledOff();
    ledThree.ledOff();
}
```

## src/DebugBlinker.hpp
```c
#ifndef DEBUGBLINKER_HPP
#define DEBUGBLINKER_HPP
//Basically the more c++ version of #define LEDCOUNT 4. These are c++11 standard: can be replaced with a plain #define macro if c++11 is covered.
constexpr int USABLE_LED_COUNT = 3;

//LED 4 is reserved for exceptions only as exception handling is not supported. Once an exception has been declared, it cannot lit off.
void declareException();
bool exceptionIsDeclared();
//this is the most ineffective method of relaying information but
//in some simple situations it might be beneficial to debug something just by counting blinks...
//this function is blocking and intentionally takse a long time to execute.
void numberToBlinks(int number);

class DebugBlinker
{
    int led;
    //every element after public: is free to use by anything outside this class. This is opposed to a private variable which is only for
    //classes internal usage. There is also protected, but we probably won't be using inheritance in this project
    //the technical difference between struct and class in c++ is that struct has it's members declared public by default and
    //class has them as private.
    public:
    //note that led number is reflective of the physical markings in the board. LED1 is led index 1 as opposed to led 0 like it's treated as in Zephyr.
    //this policy is an effort order to avoid confusion. Time will tell if it backfires...
    DebugBlinker(int led_);

    void ledOn();
    void ledOff();
    void ledToggle();
};


#endif
```

## src/DebugPrinter.cpp
```c
#include "DebugPrinter.hpp"
#include <stdio.h>
#include <zephyr.h>

bool DPInitialized = false;


#define ITM_ENA   (*(volatile unsigned int*)0xE0000E00) // ITM Enable
#define ITM_TPR   (*(volatile unsigned int*)0xE0000E40) // Trace Privilege
                                                        // Register
#define ITM_TCR   (*(volatile unsigned int*)0xE0000E80) // ITM Trace Control Reg.
#define ITM_LSR   (*(volatile unsigned int*)0xE0000FB0) // ITM Lock Status
                                                        // Register
#define DHCSR     (*(volatile unsigned int*)0xE000EDF0) // Debug register
#define DEMCR     (*(volatile unsigned int*)0xE000EDFC) // Debug register
#define TPIU_ACPR (*(volatile unsigned int*)0xE0040010) // Async Clock
                                                        // prescaler register
#define TPIU_SPPR (*(volatile unsigned int*)0xE00400F0) // Selected Pin Protocol
                                                        // Register
#define DWT_CTRL  (*(volatile unsigned int*)0xE0001000) // DWT Control Register
#define FFCR      (*(volatile unsigned int*)0xE0040304) // Formatter and flush
                                                        // Control Register
uint32_t _ITMPort  = 0; // The stimulus port from which SWO data is received
                   // and displayed.
uint32_t TargetDiv = 1; // Has to be calculated according to
                   // the CPU speed and the output baud rate

static void _EnableSWO() {
  uint32_t StimulusRegs;
  //
  // Enable access to SWO registers
  //
  DEMCR |= (1 << 24);
  ITM_LSR = 0xC5ACCE55;
  //
  // Initially disable ITM and stimulus port
  // To make sure that nothing is transferred via SWO
  // when changing the SWO prescaler etc.
  //
  StimulusRegs = ITM_ENA;
  StimulusRegs &= ~(1 << _ITMPort);
  ITM_ENA = StimulusRegs; // Disable ITM stimulus port
  ITM_TCR = 0; // Disable ITM
  //
  // Initialize SWO (prescaler, etc.)
  //
  TPIU_SPPR = 0x00000002; // Select NRZ mode
  TPIU_ACPR = TargetDiv - 1; // Example: 72/48 = 1,5 MHz
  ITM_TPR = 0x00000000;
  DWT_CTRL = 0x400003FE;
  FFCR = 0x00000100;
  //
  // Enable ITM and stimulus port
  //
  ITM_TCR = 0x1000D; // Enable ITM
  ITM_ENA = StimulusRegs | (1 << _ITMPort); // Enable ITM stimulus port
}

#define ITM_STIM_U32 (*(volatile unsigned int*)0xE0000000) // STIM word access
#define ITM_STIM_U8  (*(volatile         char*)0xE0000000) // STIM Byte access
#define ITM_ENA      (*(volatile unsigned int*)0xE0000E00) // ITM Enable Register
#define ITM_TCR      (*(volatile unsigned int*)0xE0000E80) // ITM Trace Control
                                                           // Register
void SWO_PrintChar(char c) {
  //
  // Check if ITM_TCR.ITMENA is set
  //
  if ((ITM_TCR & 1) == 0) {
    return;
  }
  //
  // Check if stimulus port is enabled
  //
  if ((ITM_ENA & 1) == 0) {
    return;
  }
  //
  // Wait until STIMx is ready,
  // then send data
  //
  while ((ITM_STIM_U8 & 1) == 0);
  ITM_STIM_U8 = c;
}


void SWO_PrintString(const char *s) {
  //
  // Print out character per character
  //
  while (*s) {
    SWO_PrintChar(*s++);
  }
}


void SWO_PrintInt(const int number)
{
  char charBuffer[20];
  sprintf(charBuffer,"%d", number);
  SWO_PrintString(charBuffer);
}

DebugPrinter::DebugPrinter()
{
    if(!DPInitialized)
    {
        DPInitialized = true;
        //untested!
        _EnableSWO();
    }
}

void DebugPrinter::PrintString(const char* string) const
{
    SWO_PrintString(string);
}

void DebugPrinter::PrintCharacter(char c) const
{
    SWO_PrintChar(c);
}

void DebugPrinter::PrintInt(int number) const
{
    SWO_PrintInt(number);
}

const DebugPrinter& DebugPrinter::operator<<(int a) const
{
    PrintInt(a);
    return *this;
}

const DebugPrinter& DebugPrinter::operator<<(char a) const
{
    PrintCharacter(a);
    return *this;
}

const DebugPrinter& DebugPrinter::operator<<(const char* a) const
{
    PrintString(a);
    return *this;
}
```

## src/DebugPrinter.hpp
```c
#ifndef DEBUG_PRINTER_HPP
#define DEBUG_PRINTER_HPP

class DebugPrinter
{
    public:
    DebugPrinter();
    void PrintString(const char* string) const;
    void PrintCharacter(char c) const;
    void PrintInt(int number) const;
    const DebugPrinter& operator<<(const int a) const;
    const DebugPrinter& operator<<(char a) const;
    const DebugPrinter& operator<<(const char* a) const;
};


#endif
```

## src/DebugSwo.h
```c
#ifndef DEBUG_SWO_H
#define DEBUG_SWO_H

#define ITM_ENA   (*(volatile unsigned int*)0xE0000E00) // ITM Enable
#define ITM_TPR   (*(volatile unsigned int*)0xE0000E40) // Trace Privilege
                                                        // Register
#define ITM_TCR   (*(volatile unsigned int*)0xE0000E80) // ITM Trace Control Reg.
#define ITM_LSR   (*(volatile unsigned int*)0xE0000FB0) // ITM Lock Status
                                                        // Register
#define DHCSR     (*(volatile unsigned int*)0xE000EDF0) // Debug register
#define DEMCR     (*(volatile unsigned int*)0xE000EDFC) // Debug register
#define TPIU_ACPR (*(volatile unsigned int*)0xE0040010) // Async Clock
                                                        // prescaler register
#define TPIU_SPPR (*(volatile unsigned int*)0xE00400F0) // Selected Pin Protocol
                                                        // Register
#define DWT_CTRL  (*(volatile unsigned int*)0xE0001000) // DWT Control Register
#define FFCR      (*(volatile unsigned int*)0xE0040304) // Formatter and flush
                                                        // Control Register
uint32_t _ITMPort  = 0; // The stimulus port from which SWO data is received
                   // and displayed.
uint32_t TargetDiv = 1; // Has to be calculated according to
                   // the CPU speed and the output baud rate

static void _EnableSWO() {
  uint32_t StimulusRegs;
  //
  // Enable access to SWO registers
  //
  DEMCR |= (1 << 24);
  ITM_LSR = 0xC5ACCE55;
  //
  // Initially disable ITM and stimulus port
  // To make sure that nothing is transferred via SWO
  // when changing the SWO prescaler etc.
  //
  StimulusRegs = ITM_ENA;
  StimulusRegs &= ~(1 << _ITMPort);
  ITM_ENA = StimulusRegs; // Disable ITM stimulus port
  ITM_TCR = 0; // Disable ITM
  //
  // Initialize SWO (prescaler, etc.)
  //
  TPIU_SPPR = 0x00000002; // Select NRZ mode
  TPIU_ACPR = TargetDiv - 1; // Example: 72/48 = 1,5 MHz
  ITM_TPR = 0x00000000;
  DWT_CTRL = 0x400003FE;
  FFCR = 0x00000100;
  //
  // Enable ITM and stimulus port
  //
  ITM_TCR = 0x1000D; // Enable ITM
  ITM_ENA = StimulusRegs | (1 << _ITMPort); // Enable ITM stimulus port
}

#define ITM_STIM_U32 (*(volatile unsigned int*)0xE0000000) // STIM word access
#define ITM_STIM_U8  (*(volatile         char*)0xE0000000) // STIM Byte access
#define ITM_ENA      (*(volatile unsigned int*)0xE0000E00) // ITM Enable Register
#define ITM_TCR      (*(volatile unsigned int*)0xE0000E80) // ITM Trace Control
                                                           // Register
void SWO_PrintChar(char c) {
  //
  // Check if ITM_TCR.ITMENA is set
  //
  if ((ITM_TCR & 1) == 0) {
    return;
  }
  //
  // Check if stimulus port is enabled
  //
  if ((ITM_ENA & 1) == 0) {
    return;
  }
  //
  // Wait until STIMx is ready,
  // then send data
  //
  while ((ITM_STIM_U8 & 1) == 0);
  ITM_STIM_U8 = c;
}


void SWO_PrintString(const char *s) {
  //
  // Print out character per character
  //
  while (*s) {
    SWO_PrintChar(*s++);
  }
}


void SWO_PrintInt(int number)
{
  char charBuffer[20];
  sprintf(charBuffer,"%d", number);
  SWO_PrintString(charBuffer);
}
#endif
```

## src/EncoderAnalyzer.cpp
```c
#include "EncoderAnalyzer.hpp"
#include "DebugPrinter.hpp"
#include "DebugBlinker.hpp"

#include <devicetree.h>
#include <drivers/adc.h>
#include <drivers/gpio.h>
#include <stdio.h>
#include <stdlib.h>
#include <string.h>
#include "hal/nrf_saadc.h"

#define ADC_NODE_LABEL DT_LABEL(DT_NODELABEL(adc))
#define SAMPLE_BUFFER_SIZE 2
#define SAMPLE_RESOLUTION 10
//SAMPLE_GAP_MILLISECONDS 0 basically means "do it ASAP"
#define SAMPLE_GAP_MILLISECONDS 0
#define INPUT_CHANNEL 1
#define OVERSAMPLING 3
#define CALIBRATE 1
#define EXTRA_SAMPLINGS 0

// Signal thresholds to compare the signal to (if its peak middle or valley)
// subject to change depending on the microcontroller used to test
#define THRESHOLD_LOW 700
#define THRESHOLD_HIGH 795

bool EA_initialized = false;
device* adcDevice;
short sampleBuffer[SAMPLE_BUFFER_SIZE] = {0};

static struct adc_channel_cfg adcChannelConfig = {
    .gain = ADC_GAIN_1_6,
    .reference = ADC_REF_INTERNAL,
    .acquisition_time = ADC_ACQ_TIME_DEFAULT,
    //WARNING: these will be defined during runtime and changing them here doesn't change anything
    .channel_id = 0,
    .differential = 0,
#if defined(CONFIG_ADC_CONFIGURABLE_INPUTS)
    .input_positive = NRF_SAADC_INPUT_AIN1,     //input negative only for differential signal
#endif
};

const struct adc_sequence_options SampleOptions = {
    .interval_us = 0,
    .callback = NULL,
    .extra_samplings = EXTRA_SAMPLINGS
};
const struct adc_sequence sampleSequence = {
.options = &SampleOptions,
.channels = BIT(INPUT_CHANNEL),
.buffer = sampleBuffer,
.buffer_size = SAMPLE_BUFFER_SIZE,
.resolution = SAMPLE_RESOLUTION,
.oversampling = OVERSAMPLING,
.calibrate = CALIBRATE
};

//constructor automatically initializes ADC. The interface of this class is channel spesific
//and the channel to be used will be given when an object is constructed. Valid channels are 0-7(?)

EncoderAnalyzer::EncoderAnalyzer()
{
    if(!EA_initialized)
    {
        //ad hoc
        targetDirection = TargetDirection::NONE;
        sample = 0;
        lastSample = 0;
        signalLevel = 0;
        //will be retrieved from memory
        encoderStep = 1;
        adcDevice = device_get_binding("ADC_0");
        //inputChannel = INPUT_CHANNEL;
        if(!adcDevice)
        {
            declareException();
            return;
        }
        adcChannelConfig.channel_id = INPUT_CHANNEL;
#if defined(CONFIG_ADC_CONFIGURABLE_INPUTS)
        adcChannelConfig.input_positive = INPUT_CHANNEL+1;
#endif
        int ret = adc_channel_setup(adcDevice, &adcChannelConfig);
        if(ret != NULL)
        {
            declareException();
        }
        EA_initialized = true;
    }
}



//fills sampleBuffer with samples
short EncoderAnalyzer::getSample()
{
    //extra samples without multiple calls to adc_read probably requires a callback function to be setup (?)
    adc_read(adcDevice, &sampleSequence);
    return sampleBuffer[0];
}

int EncoderAnalyzer::analyzeLevel(short sample){
  if (sample >= THRESHOLD_LOW){
    if (sample >= THRESHOLD_HIGH){
      return 2;
    }
    else {
      return 1;
    }
  }
  else {
    return 0;
  }
}

void EncoderAnalyzer::analyzeStep(short sample) {
  if (targetDirection == TargetDirection::UP_DIRECTION){
    if ((signalLevel != 2) && (analyzeLevel(sample) == 2)) {
      encoderStep++;
    }
  }
  else if (targetDirection == TargetDirection::DOWN_DIRECTION) {
    if ((signalLevel == 2) && (analyzeLevel(sample) != 2)) {
      encoderStep--;
    }
  }
  signalLevel = analyzeLevel(sample);
}

int EncoderAnalyzer::updateAndGetDeskPosition()
{
  short debugSample = getSample();
  DebugPrinter printer;
  printer << debugSample << " - sample voltage reading\n";
  analyzeStep(debugSample);
  return encoderStep;
}

int EncoderAnalyzer::lastDeskPosition()
{
  return encoderStep;
}
```

## src/EncoderAnalyzer.hpp
```c
#ifndef ENCODER_ANALYZER
#define ENCODER_ANALYZER

typedef enum TargetDirection
{
    NONE,
    UP_DIRECTION,
    DOWN_DIRECTION
} TargetDirection;

//WARNING: OBJECT ABSTRACTION IN THIS CLASS IS CURRENTLY BROKEN! DON'T MAKE MULTIPLE OBJECTS OF THIS CLASS.
//maintenance required.
class EncoderAnalyzer
{
    int signalLevel;
    int encoderStep; // desk position is converted from this value
    
    // lastSample is the sample from the previous adc reading.
    short lastSample;
    short sample;

    // we know the direction of the encoder from the control signal (bluetooth or button).
    // 1 is up 0 is down.
    // for now it is 1.
    TargetDirection targetDirection;
    
    //int inputChannel = INPUT_CHANNEL;
    
    // levelAnalyzer checks where the sample is in the expected signal.
    // 0 is the valley, 1 is middle and 2 the peak.
    // we only need positions 0 and 1 but position 2 is still here if we want
    // to know the direction from the signal at some later time.
    int analyzeLevel(short sample);
    
    // Keeps track of the position by updating encoderStep.
    void analyzeStep(short sample);
    //gets a single sample from the adc
    short getSample();
    public:
    EncoderAnalyzer();
    //WARNING: CURRENTLY THIS FUNCTION IS BLOCKING AND HAS TO BE EXECUTED REPEATEDLY FOR CORRECT READINGS
    int updateAndGetDeskPosition();
    int lastDeskPosition();
    void setTargetDirection(TargetDirection newDirection) { targetDirection = newDirection; }
    TargetDirection getTargetDirection() { return targetDirection; }
};


#endif
```

## src/MotorController.cpp
```c
#include "MotorController.hpp"

#include "DebugBlinker.hpp"
#include <zephyr.h>
#include <devicetree.h>
#include <drivers/gpio.h>
#include <dt-bindings/gpio/gpio.h>
#include "DebugPrinter.hpp"
//Button up input pin 1 of device GPIO_1 is (ARDUINO D0, p1.01) in nrf52840dk
#define BUTTON_UP_INPUT 1
//p1.02
#define BUTTON_DOWN_INPUT 2
//p1.04
#define BUTTON_UP_OUTPUT 4
//p1.05
#define BUTTON_DOWN_OUTPUT 5


struct device* pinDevice;
bool MCInitialized = false;

MotorController::MotorController()
{
    setState(ControlState::BUTTON);
    targetHeight = -1;
    if(!MCInitialized)
    {
        MCInitialized = true;
        pinDevice = device_get_binding("GPIO_1");
        
        if(pinDevice == NULL)
        {
            declareException();
        }
        //init digital input pins
        gpio_pin_configure(pinDevice, BUTTON_UP_INPUT, GPIO_INPUT);
        gpio_pin_configure(pinDevice, BUTTON_DOWN_INPUT, GPIO_INPUT);
        //init digital output pins
        gpio_pin_configure(pinDevice, BUTTON_DOWN_OUTPUT, GPIO_OUTPUT_LOW);
        gpio_pin_configure(pinDevice, BUTTON_UP_OUTPUT, GPIO_OUTPUT_LOW);
    }
}

ButtonState MotorController::readButtonState()
{
    int retUP = gpio_pin_get_raw(pinDevice, BUTTON_UP_INPUT);
    int retDOWN = gpio_pin_get_raw(pinDevice, BUTTON_DOWN_INPUT);

    if( retUP == 1 && retDOWN == 0)
    {
        return ButtonState::DOWN;
    }
    else if(retUP == 0 && retDOWN == 1)
    {
        return ButtonState::UP;
    }
    else if(retUP == 0 && retDOWN == 0)
    {
        return ButtonState::BOTH;
    }
    else if(retUP == 1 && retDOWN == 1)
    {
        return ButtonState::NOT_PRESSED;
    }
    else
    {
        //in case of an unknown state the safest signal to send is ButtonState::NOT_PRESSED as then it won't move the desk due to potential error states
        declareException();
        return ButtonState::NOT_PRESSED;
    }
}

void MotorController::steerMotor(ButtonState directive)
{
    DebugPrinter printer;
    if(directive == ButtonState::UP)
    {
        gpio_pin_set_raw(pinDevice, BUTTON_UP_OUTPUT, 1);
        gpio_pin_set_raw(pinDevice, BUTTON_DOWN_OUTPUT, 0);
        printer << "UP\n";
    }
    else if(directive == ButtonState::DOWN)
    {
        gpio_pin_set_raw(pinDevice, BUTTON_UP_OUTPUT, 0);
        gpio_pin_set_raw(pinDevice, BUTTON_DOWN_OUTPUT, 1);
        printer << "DOWN\n";
    }
    else if(directive == ButtonState::BOTH)
    {
        gpio_pin_set_raw(pinDevice, BUTTON_UP_OUTPUT, 1);
        gpio_pin_set_raw(pinDevice, BUTTON_DOWN_OUTPUT, 1);
        printer << "BOTH\n";
    }
    else
    {
        printer << "NOTPRESSED\n";
        gpio_pin_set_raw(pinDevice, BUTTON_UP_OUTPUT, 0);
        gpio_pin_set_raw(pinDevice, BUTTON_DOWN_OUTPUT, 0);
    }
}

bool MotorController::steerTowardsTarget(int tableHeight)
{
    if(targetHeight < 0)
    {
        return true;
    }
    if(analyzer.getTargetDirection() == TargetDirection::DOWN_DIRECTION)
    {
        //goal reached
        if(tableHeight <= targetHeight)
        {
            return true;
        }
        //keep steering
        else
        {
            steerMotor(ButtonState::DOWN);
        }
    }
    else if(analyzer.getTargetDirection() == TargetDirection::UP_DIRECTION)
    {
        //goal reached
        if(tableHeight >= targetHeight)
        {
            return true;
        }
        //keep steering
        else
        {
            steerMotor(ButtonState::UP);
        }
    }
    else
    {
        //this shouldnt happen. If we get here there's a bug in code.
        declareException();
        return true;
    }
    //goal has not been reached
    return false;
}

ControlState MotorController::controlStateButton(int tableHeight, ButtonState buttonState)
{
    if(buttonState == ButtonState::NOT_PRESSED)
    {
        steerMotor(ButtonState::NOT_PRESSED);
        analyzer.setTargetDirection(TargetDirection::NONE);
    }
    else if(buttonState == ButtonState::DOWN)
    {
        analyzer.setTargetDirection(TargetDirection::DOWN_DIRECTION);
        //user wants to steer downwards via button press
        steerMotor(ButtonState::DOWN);
    }
    else if(buttonState == ButtonState::UP)
    {
        //user wants to steer upwards via button press
        analyzer.setTargetDirection(TargetDirection::UP_DIRECTION);
        steerMotor(ButtonState::UP);
    }
    else if(buttonState == ButtonState::BOTH)
    {
        //no idea what is supposed to happen
        steerMotor(ButtonState::BOTH);
    }
    return ControlState::BUTTON;
}
ControlState MotorController::controlStateBluetooth(int tableHeight, ButtonState buttonState)
{
    if(buttonState != ButtonState::NOT_PRESSED)
    {
        return ControlState::BUTTON;
    }
    //target achieved
    if(steerTowardsTarget(tableHeight))
    {
        analyzer.setTargetDirection(TargetDirection::NONE);
        targetHeight = -1;
        return ControlState::BUTTON;
    }
    return ControlState::BLUETOOTH;
}

void MotorController::run()
{
    DebugPrinter printer;
    while(1)
    {
        k_msleep(1);
        //these steps are the same for every state
        int tableHeight = analyzer.updateAndGetDeskPosition();
        ButtonState buttonState = readButtonState();
        //finite state machine spesific states
        printer << "STATE: " << getState() << "\n" << " tableHeight: " << tableHeight << "\n";
        switch (getState())
        {
        case ControlState::BUTTON:
            setState(controlStateButton(tableHeight, buttonState));
            break;
        case ControlState::BLUETOOTH:
            setState(controlStateBluetooth(tableHeight, buttonState));
            break;
        default:
            //currently this should be logically impossible. There is no designated error state
            declareException();
            break;
        }
    }
};

ControlState MotorController::getState()
{
    return controlState;
}

void MotorController::setState(ControlState newState)
{
    controlState = newState;
}

void MotorController::steerRequest(int newTargetHeight)
{
    setState(ControlState::BLUETOOTH);
    targetHeight = newTargetHeight;
    if( analyzer.lastDeskPosition() < newTargetHeight )
    {
        analyzer.setTargetDirection(TargetDirection::UP_DIRECTION);
    }
    else if( analyzer.lastDeskPosition() > newTargetHeight )
    {
        analyzer.setTargetDirection(TargetDirection::DOWN_DIRECTION);
    }
    else
    {
        analyzer.setTargetDirection(TargetDirection::NONE);
        targetHeight = -1;
        declareException();
    }
}
```

## src/MotorController.hpp
```c
#ifndef MOTOR_CONTROLLER_HPP
#define MOTOR_CONTROLLER_HPP

#include "EncoderAnalyzer.hpp"

typedef enum ButtonState {
    NOT_PRESSED,
    UP,
    DOWN,
    BOTH,
} ButtonState;

//MotorController essentially functions as a finite state machine with two states: BUTTON and BLUETOOTH which may transition from one to another
typedef enum ControlState {
    BUTTON,
    BLUETOOTH
} ControlState;

class MotorController {
    EncoderAnalyzer analyzer;
    //DO NOT CHANGE THE VALUE OF THIS DIRECTLY! USE GETTERS AND SETTERS there might be a need for getters or setters later on
    ControlState controlState;
    int targetHeight;
    ButtonState readButtonState();
    void steerMotor(ButtonState directive);
    //returns true if target has been reached, false if not
    bool steerTowardsTarget(int tableHeight);
    ControlState controlStateButton(int tableHeight, ButtonState buttonState);
    ControlState controlStateBluetooth(int tableHeight, ButtonState buttonState);
    void setState(ControlState newState);
    public:
    ControlState getState();
    MotorController();
    void steerRequest(int newTargetHeight);
    //a forever blocking function that should either have it's own seperate thread or be the program's main loop
    void run();
};

#endif
```
